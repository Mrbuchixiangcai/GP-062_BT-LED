/*************************************************************/
/*头文件Header File*******************************************/
/*************************************************************/
#include "app_main.h"

/*************************************************************/
/*宏定义Macro Definition**************************************/
/*************************************************************/

/*************************************************************/
/*类型定义Byte Definition**************************************/
/*************************************************************/

/*************************************************************/
/*标志位定义Flags Definition***********************************/
/*************************************************************/

/*************************************************************/
/*变量定义Variable Definition**********************************/
/*************************************************************/

/*************************************************************/
/*数组定义Array Definition************************************/
/*************************************************************/

/*************************************************************/
/*函数声明Function Declaration*********************************/
/*************************************************************/

/*************************************************************/
/*函数定义Function Definition**********************************/
/*************************************************************/
/*******************************************************************************
* 函数原型：
* 输入参数：
* 输出参数：
* 函数功能：
* 返回值说明：
* 创建日期：
* 创建人：
* 修改日期
* 修改人：
* 第N次修改：
* 修改原因：
* 备注：
*******************************************************************************/
void DataBackups(void)
{
	Alarm1PowerOFF();
	Display_Off();
	gRTC_Hour_bk   = gRTC_Hour;
	gRTC_Minute_bk = gRTC_Minute;
	gRTC_Day_bk    = gRTC_Day;
	gRTC_Month_bk  = gRTC_Month;
	gRTC_Year_bk   = gRTC_Year;
	gRTC_Zone_bk   = gRTC_Zone;
}

/*******************************************************************************
* 函数原型：
* 输入参数：
* 输出参数：
* 函数功能：把端口设置为省电模式
* 返回值说明：
* 创建日期：
* 创建人：
* 修改日期
* 修改人：
* 第N次修改：
* 修改原因：
* 备注：
*******************************************************************************/
void SetGPIO_Sleep(void)
{
	P0 = 0x00;
	P1 = 0x00;
	P2 = 0x00;
	P3 = 0x00;
	P4 = 0x00;
	P5 = 0x00;
	P6 = 0x00;
}

/*******************************************************************************
* 函数原型：
* 输入参数：
* 输出参数：
* 函数功能：关闭定时器Timer0,把端口设置为睡眠状态
* 返回值说明：
* 创建日期：
* 创建人：
* 修改日期
* 修改人：
* 第N次修改：
* 修改原因：
* 备注：
*******************************************************************************/
void InitT0_Sleep(void)
{
	LVRCR = 0x01;  // 进 IDLE/STOP 不打开低压复位，低压复位关闭 0x01
	IE2 &= ~0x12;  // 关闭定时器 T0和T3 中断
	T0CR &= ~0x80; // 关闭 T0 定时器
	T3CR &= ~0x80; // 关闭 T0 定时器
	SetGPIO_Sleep();  // 配置省电模式 IO 口
}

/*******************************************************************************
* 函数原型：
* 输入参数：
* 输出参数：
* 函数功能：
* 返回值说明：
* 创建日期：
* 创建人：
* 修改日期
* 修改人：
* 第N次修改：
* 修改原因：
* 备注：
*******************************************************************************/
void CLKToCRYL(void)
{
	SCCR = 0x02;      //外部副时钟做主时钟
	OSCCR |= 0x04;    //关闭内部RC，关闭外部副时钟振荡器
}

/*******************************************************************************
* 函数原型：
* 输入参数：
* 输出参数：
* 函数功能：进入STOP/IDLE模式之后必须立即写入三个以上的 NOP指令
* 返回值说明：
* 创建日期：
* 创建人：
* 修改日期
* 修改人：
* 第N次修改：
* 修改原因：
* 备注：
*******************************************************************************/
void IN_IDLE_Delay(void)
{
	uint8_t idata tp0;//延时专用临时变量
	for(tp0=0;tp0<=10;tp0++)
		;
}

/*******************************************************************************
* 函数原型：
* 输入参数：
* 输出参数：
* 函数功能：系统初始化，用在掉电再上电之后
* 返回值说明：
* 创建日期：
* 创建人：
* 修改日期
* 修改人：
* 第N次修改：
* 修改原因：
* 备注：
*******************************************************************************/
void System_init(void)
{
	cli();          	// disable INT. during peripheral setting
	port_init();    	// initialize ports
	clock_init();   	// initialize operation clock
	BUZ_init();     	// initialize Buzzer
	LCD_init();     	// initialize LCD
	Timer0_init();  	// initialize Timer0
	Timer3_init();  	// initialize Timer3
	sei();          	// enable INT.
}

/*******************************************************************************
* 函数原型：
* 输入参数：
* 输出参数：
* 函数功能：
* 返回值说明：
* 创建日期：
* 创建人：
* 修改日期
* 修改人：
* 第N次修改：
* 修改原因：
* 备注：
*******************************************************************************/
uint8_t  cntCheckDC_IDLE; //检测到低电压计数，然后到了100ms之后还是低就关闭显示
void CheckDC(void)
{
	uint8_t i;
	uint8_t data cntIDLE;
	if(!CHECK_DC_DEC())//检测到电压降低，然后进入这里
	{
		cntCheckDC_IDLE++;
		if(cntCheckDC_IDLE<=10)//100ms
		{
			return;//延时100ms
		}
		cntCheckDC_IDLE=12;
		DataBackups();
		Flag_PowerOn=0;
		InitT0_Sleep();
		CLKToCRYL();
		while(1)
		{
			PCON=0x01;  //进入IDLE省点模式
			IN_IDLE_Delay();//进入IDLE专用的3个NOP延时
			cntIDLE=0;
			while((!CHECK_DC_DEC()))
			{
				for(i=0;i<16;i++)
						;
				if(++cntIDLE>=4)//延时确定是否上电
					break;
			}
			if(cntIDLE>=4)
				break;
			System_init();//重新上DC初始化
			gRTC_Hour   = gRTC_Hour_bk;
			gRTC_Minute = gRTC_Minute_bk;
			gRTC_Day    = gRTC_Day_bk;
			gRTC_Month  = gRTC_Month_bk;
			gRTC_Year   = gRTC_Year_bk;
			gRTC_Zone   = gRTC_Zone_bk;
		}
	}
}












